## meta-rpilinux/conf/layer.conf
```bitbake
# We have a conf and classes directory, add to BBPATH
BBPATH .= ":${LAYERDIR}"

# We have recipes-* directories, add to BBFILES
BBFILES += "${LAYERDIR}/recipes-*/*/*.bb \
${LAYERDIR}/recipes-*/*/*.bbappend"

BBFILE_COLLECTIONS += "rpilinux"
BBFILE_PATTERN_rpilinux = "^${LAYERDIR}/"
BBFILE_PRIORITY_rpilinux = "6"

LAYERSERIES_COMPAT_rpilinux = "kirkstone" 

DISTRO_FEATURES += " eglfs gles2 ipv4 ipv6 systemd rauc"
VIRTUAL-RUNTIME_init_manager = "systemd"
VIRTUAL-RUNTIME_initscripts = ""

IMAGE_FEATURES:remove = "read-only-rootfs"
IMAGE_FEATURES:append = " hwcodecs"

IMAGE_FSTYPES="tar.bz2 ext4 wic.bz2 wic.bmap"

ENABLE_UART = "1"
RPI_USE_U_BOOT = "1"
PREFERRED_PROVIDER_virtual/bootloader = "u-boot"
```

## meta-rpilinux/wic/rpilinux-partitions.wks
```
# short-description: Create Raspberry Pi SD card image
# long-description: Creates a partitioned SD card image for use with
# Raspberry Pi. Boot files are located in the first vfat partition.

part /boot --source bootimg-partition --ondisk mmcblk0 --fstype=vfat --label boot --active --align 4096 --size 20
part / --source rootfs --ondisk mmcblk0 --fstype=ext4 --label rootA --align 4096 --size 3G
part / --ondisk mmcblk1 --fstype=ext4 --label rootB --align 4096 --size 3G
part / --ondisk mmcblk1 --fstype=ext4 --label data --align 4096 --size 512M
```
